#include "board.h"
#include "delay.h"
#include "usart.h"
#include "Emm_V5.h"

/**********************************************************
***	Emm_V5.0步进闭环控制例程
***	编写作者：ZHANGDATOU
***	技术支持：张大头闭环伺服
***	淘宝店铺：https://zhangdatou.taobao.com
***	CSDN博客：http s://blog.csdn.net/zhangdatou666
***	qq交流群：262438510
**********************************************************/

  // 定义实时转速全局变量
  float vel = 0.0f, Motor_Vel = 0.0f;

/**
	*	@brief		MAIN函数
	*	@param		无
	*	@retval		无
	*/
int main(void)
{
/**********************************************************
***	初始化板载外设
**********************************************************/
	board_init();

/**********************************************************
***	上电延时2秒等待Emm_V5.0闭环初始化完毕
**********************************************************/	
	delay_ms(2000);

/**********************************************************
***	速度模式：方向CW，速度1000RPM，加速度0（不使用加减速直接启动）
**********************************************************/	
  Emm_V5_Vel_Control(1, 0, 1000, 0, 0);
	
/**********************************************************
***	等待返回命令，命令数据缓存在数组rxCmd上，长度为rxCount
**********************************************************/	
	while(rxFrameFlag == false); rxFrameFlag = false;

/**********************************************************
***	延时1秒，等待转速到达
**********************************************************/	
  delay_ms(1000);

/**********************************************************
***	读取电机实时转速
**********************************************************/	
  Emm_V5_Read_Sys_Params(1, S_VEL);

/**********************************************************
***	等待返回命令，命令数据缓存在数组rxCmd上，长度为rxCount
**********************************************************/	
	while(rxFrameFlag == false); rxFrameFlag = false;

/**********************************************************
***	校验地址、功能码、返回数据长度，校验成功则计算当前转速，单位：RPM（转/分钟）
**********************************************************/	
  if(rxCmd[0] == 1 && rxCmd[1] == 0x35 && rxCount == 6)
  {
    // 拼接成uint16_t类型数据
    vel = (uint16_t)(
                      ((uint16_t)rxCmd[3] << 8)   |
                      ((uint16_t)rxCmd[4] << 0)
                    );

    // 实时转速
    Motor_Vel = vel;

    // 符号
    if(rxCmd[2]) { Motor_Vel = -Motor_Vel; }
  }

/**********************************************************
***	WHILE循环
**********************************************************/	
	while(1)
	{
	}
}
